/*
 * Copyright (C) 2019 Atmark Techno, Inc. All Rights Reserved.
 * Author: Akihito Irie <akihito.irie@atmark-techno.com>
 *
 * This program is free software; you can redistribute it and/or
 * modify it under the terms of the GNU General Public License
 * version 2 as published by the Free Software Foundation.
 */

#include "../../../../arch/arm/boot/dts/imx7d-pinfunc.h"

/dts-v1/;
/plugin/;
/ {
	fragment@0 {
		target = <&iomuxc>;
		__overlay__ {
			addon-intf1 {
				pinctrl_ecspi1: ecspi1grp {
					fsl,pins = <
						MX7D_PAD_ECSPI2_MOSI__GPIO4_IO21	0x30	/* INTF1_40 */
						MX7D_PAD_ECSPI2_SCLK__GPIO4_IO20	0x30	/* INTF1_41 */
						MX7D_PAD_ECSPI2_MISO__GPIO4_IO22	0x30	/* INTF1_39 */
						MX7D_PAD_ECSPI2_SS0__GPIO4_IO23		0x30	/* INTF1_38 */
						MX7D_PAD_UART3_TX_DATA__GPIO4_IO5	0x30	/* INTF1_37 */
						MX7D_PAD_UART3_RX_DATA__GPIO4_IO4	0x30	/* INTF1_36 */
						MX7D_PAD_UART3_RTS_B__GPIO4_IO6		0x30	/* INTF1_35 */
						MX7D_PAD_UART2_TX_DATA__GPIO4_IO3	0x30	/* INTF1_34 */
						MX7D_PAD_UART2_RX_DATA__GPIO4_IO2	0x30	/* INTF1_33 */
						MX7D_PAD_SAI1_MCLK__GPIO6_IO18		0x30	/* INTF1_32 */
						MX7D_PAD_SAI1_RX_BCLK__GPIO6_IO17	0x30	/* INTF1_43 */
						MX7D_PAD_SAI1_RX_SYNC__GPIO6_IO16	0x30	/* INTF1_42 */
					>;
				};
			};
		};
	};
};
