/*
 * Copyright (C) 2017 Atmark Techno, Inc. All Rights Reserved.
 * Author: Daisuke Mizobuchi <mizo@atmark-techno.com>
 *
 * This program is free software; you can redistribute it and/or
 * modify it under the terms of the GNU General Public License
 * version 2 as published by the Free Software Foundation.
 */

#include <dt-bindings/clock/imx7d-clock.h>
#include "../../../../arch/arm/boot/dts/imx7d-pinfunc.h"

/dts-v1/;
/plugin/;
/ {
	fragment@0 {
		target = <&iomuxc>;
		__overlay__ {
			addon-intf1 {
				pinctrl_uart7: uart7grp {
					fsl,pins = <
						MX7D_PAD_SAI1_MCLK__GPIO6_IO18		0x00	/* INTF1_32 */
						MX7D_PAD_UART2_RX_DATA__GPIO4_IO2	0x00	/* INTF1_33 */
						MX7D_PAD_ECSPI2_MOSI__UART7_DCE_TX	0x00	/* INTF1_40 */
						MX7D_PAD_ECSPI2_SCLK__UART7_DCE_RX	0x70	/* INTF1_41 */
					>;
				};
			};
		};
	};

	fragment@1 {
		target = <&uart7>;
		__overlay__ {
			pinctrl-names = "default";
			pinctrl-0 = <&pinctrl_uart7>;

			rs485-enabled-at-boot-time;
			rs485-rts-active-high;
			rts-gpio = <&gpio6 18 0>;
			fsl,uart-has-rtscts;
			status = "okay";
		};
	};
};
