/*
 * Copyright (C) 2017 Atmark Techno, Inc. All Rights Reserved.
 * Author: Daisuke Mizobuchi <mizo@atmark-techno.com>
 *
 * This program is free software; you can redistribute it and/or
 * modify it under the terms of the GNU General Public License
 * version 2 as published by the Free Software Foundation.
 */

#include <dt-bindings/clock/imx7d-clock.h>
#include "../../../../arch/arm/boot/dts/imx7d-pinfunc.h"

/dts-v1/;
/plugin/;
/ {
	fragment@0 {
		target = <&iomuxc>;
		__overlay__ {
			addon-intf2 {
				pinctrl_uart2: uart2grp {
					fsl,pins = <
						MX7D_PAD_LCD_VSYNC__UART2_DCE_CTS	0x00	/* INTF2_38 */
						MX7D_PAD_LCD_HSYNC__UART2_DCE_RTS	0x10	/* INTF2_39 */
						MX7D_PAD_LCD_ENABLE__UART2_DCE_TX	0x00	/* INTF2_40 */
						MX7D_PAD_LCD_CLK__UART2_DCE_RX		0x70	/* INTF2_41 */
						MX7D_PAD_I2C3_SCL__GPIO4_IO12		0x00	/* INTF2_42 */
						MX7D_PAD_I2C3_SDA__GPIO4_IO13		0x00	/* INTF2_43 */
					>;
				};
			};
		};
	};

	fragment@1 {
		target = <&uart2>;
		__overlay__ {
			pinctrl-names = "default";
			pinctrl-0 = <&pinctrl_uart2>;
			fsl,uart-has-rtscts;
			status = "okay";
		};
	};
};
