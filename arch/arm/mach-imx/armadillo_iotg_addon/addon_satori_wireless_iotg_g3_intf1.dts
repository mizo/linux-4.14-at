/*
 * Copyright (C) 2017 Atmark Techno, Inc. All Rights Reserved.
 * Author: Daisuke Mizobuchi <mizo@atmark-techno.com>
 *
 * This program is free software; you can redistribute it and/or
 * modify it under the terms of the GNU General Public License
 * version 2 as published by the Free Software Foundation.
 */

#include <dt-bindings/clock/imx7d-clock.h>
#include "../../../../arch/arm/boot/dts/imx7d-pinfunc.h"

/dts-v1/;
/plugin/;
/ {
	fragment@0 {
		target = <&iomuxc>;
		__overlay__ {
			addon-intf1 {
				pinctrl_uart1: uart1grp {
					fsl,pins = <
						MX7D_PAD_ENET1_RGMII_RD0__UART1_DCE_CTS	0x00	/* INTF1_38 */
						MX7D_PAD_ENET1_RGMII_RD1__UART1_DCE_RTS	0x10	/* INTF1_39 */
						MX7D_PAD_UART1_TX_DATA__UART1_DCE_TX	0x00	/* INTF1_40 */
						MX7D_PAD_UART1_RX_DATA__UART1_DCE_RX	0x70	/* INTF1_41 */

						MX7D_PAD_ENET1_RGMII_RX_CTL__GPIO7_IO4	0x00	/* INTF1_42 */
						MX7D_PAD_ENET1_RGMII_RXC__GPIO7_IO5	0x00	/* INTF1_43 */
						MX7D_PAD_ENET1_TX_CLK__GPIO7_IO12	0x00	/* INTF1_32 */
					>;
				};
			};
		};
	};

	fragment@1 {
		target = <&uart1>;
		__overlay__ {
			pinctrl-names = "default";
			pinctrl-0 = <&pinctrl_uart1>;
			fsl,uart-has-rtscts;
			status = "okay";
		};
	};
};
