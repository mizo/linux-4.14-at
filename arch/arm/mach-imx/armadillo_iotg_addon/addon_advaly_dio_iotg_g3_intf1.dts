/*
 * Copyright (C) 2019 Atmark Techno, Inc. All Rights Reserved.
 * Author: Akihito Irie <akihito.irie@atmark-techno.com>
 *
 * This program is free software; you can redistribute it and/or
 * modify it under the terms of the GNU General Public License
 * version 2 as published by the Free Software Foundation.
 */

#include "../../../../arch/arm/boot/dts/imx7d-pinfunc.h"

/dts-v1/;
/plugin/;
/ {
	fragment@0 {
		target = <&iomuxc>;
		__overlay__ {
			addon-intf1 {
				pinctrl_ecspi2: ecspi2grp {
					fsl,pins = <
						MX7D_PAD_UART1_TX_DATA__GPIO4_IO1	0x30	/* INTF1_40 */
						MX7D_PAD_UART1_RX_DATA__GPIO4_IO0	0x30	/* INTF1_41 */
						MX7D_PAD_ENET1_RGMII_RD1__GPIO7_IO1	0x30	/* INTF1_39 */
						MX7D_PAD_ENET1_RGMII_RD0__GPIO7_IO0	0x30	/* INTF1_38 */
						MX7D_PAD_ENET1_RGMII_RD3__GPIO7_IO3	0x30	/* INTF1_37 */
						MX7D_PAD_ENET1_RGMII_TD2__GPIO7_IO8	0x30	/* INTF1_36 */
						MX7D_PAD_ENET1_RGMII_RD2__GPIO7_IO2	0x30	/* INTF1_35 */
						MX7D_PAD_ENET1_RGMII_TD1__GPIO7_IO7	0x30	/* INTF1_34 */
						MX7D_PAD_ENET1_RX_CLK__GPIO7_IO13	0x30	/* INTF1_33 */
						MX7D_PAD_ENET1_TX_CLK__GPIO7_IO12	0x30	/* INTF1_32 */
						MX7D_PAD_ENET1_RGMII_RXC__GPIO7_IO5	0x30	/* INTF1_43 */
						MX7D_PAD_ENET1_RGMII_RX_CTL__GPIO7_IO4	0x30	/* INTF1_42 */
					>;
				};
			};
		};
	};
};
